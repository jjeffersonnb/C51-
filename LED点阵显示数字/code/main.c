#include <reg51.h>
unsigned char code tab[]={0xfe,0xfd,0xfb,0xf7,0xef,0xdf,0xbf,0x7f};//列线值
unsigned char code digittab[10][8]={
{0x00,0x00,0x3e,0x41,0x41,0x41,0x3e,0x00}, //数字0的行值
{0x00,0x00,0x00,0x00,0x21,0x7f,0x01,0x00}, //1
{0x00,0x00,0x27,0x45,0x45,0x45,0x39,0x00}, //2
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{0x00,0x00,0x32,0x49,0x49,0x49,0x3e,0x00} 		//9
};
unsigned int timecount;					//定义定时次数变量
unsigned char lie;						//定义列变量
unsigned char shu;						//定义要显示数字的顺序变量

void main(void)
{
	TMOD=0x01;							//定时器0初始化，打开中断，定时3ms 
	TH0=(65536-3000)/256;
	TL0=(65536-3000)%256;
	TR0=1;
	ET0=1;
	EA=1;
	while(1);							//等定时器中断	
}

void t0(void) interrupt 1				//定时器0中断服务程序
{
	TH0=(65536-3000)/256;		//重装初值
	TL0=(65536-3000)%256;
	P3=tab[lie];				//送列值
	P0=digittab[shu][lie];		//送行值
	lie++;						//列值加1
	if(lie==8)lie=0;			//8列扫描完，列值归0 
	timecount++;
	if(timecount==333)			//显示时间满1s
	{
		timecount=0;			//定时次数清0 
		shu++;					//换下一个数字
		if(shu==10)				//0～9显示完
			shu=0;				//再从0开始			
	}
}
